## project/first/first_project/components/BSP/Kconfig
```kconfig
menu "蝴蝶 V1 飞控板 BSP"

    config BSP_SERVO_PWM_HZ
        int "舵机 PWM 频率 (Hz)"
        range 50 333
        default 50
        help
            50 Hz 所有舵机都能用。数码舵机可改 200~333 Hz 降低延迟；
            模拟舵机超过 50 Hz 会发热甚至烧毁。

    config BSP_SERVO_MIN_US
        int "舵机 0° 对应脉宽 (us)"
        default 500

    config BSP_SERVO_MAX_US
        int "舵机 180° 对应脉宽 (us)"
        default 2500

    config BSP_SERVO_OPTO_INVERT
        bool "舵机信号经过光耦反相（V1 板 U9/U10）"
        default y
        help
            IO 高 -> 光耦导通 -> 舵机侧被拉低，所以 LEDC 输出必须反相。
            只有把光耦短接改成直连时才关闭。

    config BSP_LED_ACTIVE_HIGH
        bool "状态灯高电平点亮"
        default y
        help
            V1 板 IO10 驱动 SI2302 NMOS 栅极，高电平点亮。

    menu "IMU 安装方向（传感器轴 -> 机体轴）"
        comment "机体系：X 向前（头）、Y 向右、Z 向下。芯片 Z 轴朝板子正面。"

        choice BSP_IMU_BODY_X
            prompt "机体 X（前）取自"
            default BSP_IMU_BODY_X_POS_X
            config BSP_IMU_BODY_X_POS_X
                bool "+X"
            config BSP_IMU_BODY_X_NEG_X
                bool "-X"
            config BSP_IMU_BODY_X_POS_Y
                bool "+Y"
            config BSP_IMU_BODY_X_NEG_Y
                bool "-Y"
        endchoice

        choice BSP_IMU_BODY_Y
            prompt "机体 Y（右）取自"
            default BSP_IMU_BODY_Y_NEG_Y
            config BSP_IMU_BODY_Y_POS_X
                bool "+X"
            config BSP_IMU_BODY_Y_NEG_X
                bool "-X"
            config BSP_IMU_BODY_Y_POS_Y
                bool "+Y"
            config BSP_IMU_BODY_Y_NEG_Y
                bool "-Y"
        endchoice

        config BSP_IMU_BOARD_TOP_UP
            bool "板子正面朝上安装（芯片 Z 朝天）"
            default y
            help
                正面朝上时机体 Z（向下）= 芯片 -Z。
                X/Y 选择必须和 Z 构成右手系，否则启动时报错。
    endmenu

endmenu
```

## project/first/first_project/components/flight_control/Kconfig
```kconfig
menu "蝴蝶飞控参数"

    config FC_MECH_CONFIRMED
        bool "机构参数已在台架确认（允许解锁扑翼）"
        default n
        help
            关闭时飞控能跑、能连遥控、能看姿态，但安全状态机拒绝解锁。
            先不装翅膀，确认下面的中位、幅度、左右方向都对，再打开。

    config FC_DIRECT_DRIVE
        bool "直驱：机翼直接装在舵机摆臂上（康师傅 V1 机构）"
        default y
        help
            关闭则需要在 fc_config.c 里填四连杆尺寸。

    config FC_SERVO_LEFT_NEUTRAL_DEG
        int "左舵机中位 (deg)"
        range 30 150
        default 90

    config FC_SERVO_RIGHT_NEUTRAL_DEG
        int "右舵机中位 (deg)"
        range 30 150
        default 90

    config FC_SERVO_RIGHT_MIRRORED
        bool "右舵机镜像安装（同一指令两翼反向运动）"
        default y
        help
            康师傅 V1 左右舵机是镜像装的：左 = 中位 + 幅度，右 = 中位 - 幅度。

    config FC_FLAP_AMPLITUDE_DEG
        int "满油门扑翼幅度 (单侧, deg)"
        range 10 60
        default 35

    config FC_ROLL_DIFF_DEG
        int "满滚转杆左右幅度差 (deg)"
        range 0 20
        default 8

    config FC_FLAP_MIN_HZ_X10
        int "最低扑翼频率 (0.1 Hz)"
        range 10 80
        default 25

    config FC_FLAP_MAX_HZ_X10
        int "最高扑翼频率 (0.1 Hz)"
        range 20 120
        default 55
        help
            受舵机速度限制：单侧 35° 幅度时，0.1 s/60° 的舵机大约只能到 5~6 Hz。

    config FC_FAILSAFE_THROTTLE_PCT
        int "失控保护油门 (%)（遥控断开 1 s 后保持的油门）"
        range 0 100
        default 60
        help
            失控后 2 s 内从当前油门平滑过渡到这个值并保持，用来缓降。
            应略低于悬停油门（悬停油门 − 5% 左右）。升力约与幅度平方成正比，
            设得太低会直接掉下来：仿真里 35% 以 3.8 m/s 坠地，60% 约 0.7 m/s 缓降。

    config FC_DEGRADED_AMP_PCT
        int "降级幅度上限 (%)（遥控 0.3 s 没更新 / 电池低）"
        range 0 100
        default 85
        help
            短时丢包时允许的最大扑翼幅度。太低会在丢包瞬间掉高度。

    config FC_ENABLE_STABILIZE
        bool "启用增稳（角度/角速度 PID，需整定后再开）"
        default n
        help
            关闭时 PID 增益为 0，遥控器的增稳模式会自动退回手动直通。
            打开后使用 fc_config.c 中的初始增益，必须系绳试飞逐级调。

endmenu
```

## project/first/first_project/sdkconfig.defaults
```kconfig
CONFIG_IDF_TARGET="esp32c3"
CONFIG_ESPTOOLPY_FLASHSIZE_4MB=y
# 日志走 USB-Serial-JTAG（IO18/IO19），UART0（IO20/21）留给 J6
CONFIG_ESP_CONSOLE_USB_SERIAL_JTAG=y
# 1 kHz tick，400 Hz 调度更准
CONFIG_FREERTOS_HZ=1000
CONFIG_COMPILER_OPTIMIZATION_PERF=y
# esp_timer 任务优先级高于飞控任务之外的应用任务
CONFIG_ESP_TIMER_TASK_STACK_SIZE=4096
```

## project/remote/remote_project/components/BSP_RC/Kconfig
```kconfig
menu "EDU 遥控器 BSP"

    config RC_JOY_SPAN_COUNTS
        int "摇杆半行程对应的 ADC 计数"
        range 800 2048
        default 1900
        help
            原 MicroPython 代码：(raw - 中位) / 3.8 映射到 ±500，即半行程约 1900 计数。
            打满杆仍到不了 ±1000 时调小。

    config RC_JOY_DEADZONE_PERMILLE
        int "摇杆死区 (‰)"
        range 0 100
        default 20

    config RC_THROTTLE_FULL_COUNTS
        int "油门满行程 ADC 计数"
        range 2000 4095
        default 3800

    config RC_INVERT_THROTTLE
        bool "油门反向"
        default y
        help
            原代码 thr = 3000 - raw：推杆向上 ADC 变小。

    config RC_INVERT_ROLL
        bool "滚转反向"
        default y

    config RC_INVERT_PITCH
        bool "俯仰反向"
        default n

    config RC_INVERT_YAW
        bool "偏航反向"
        default y

endmenu
```

## project/remote/remote_project/sdkconfig.defaults
```kconfig
CONFIG_IDF_TARGET="esp32c3"
CONFIG_ESPTOOLPY_FLASHSIZE_4MB=y
# 日志走 USB-Serial-JTAG；IO20/IO21 是按键，不能当 UART0
CONFIG_ESP_CONSOLE_USB_SERIAL_JTAG=y
CONFIG_FREERTOS_HZ=1000
```

## project/text/sample_project_text/main/Kconfig.projbuild
```kconfig
menu "HUDI ESP-NOW 双板通信"

    config APP_ESPNOW_CHANNEL
        int "ESP-NOW 使用的 Wi-Fi 信道"
        range 1 13
        default 1
        help
            两块板必须使用同一个信道，否则收不到对方的广播包。

    config APP_LED_GPIO
        int "LED GPIO 编号"
        default 3
        help
            LED 接在该引脚上，收到对端指令时翻转。

    config APP_LED_ACTIVE_LOW
        bool "LED 低电平点亮"
        default y

    config APP_BUTTON_GPIO
        int "按键 GPIO 编号"
        default 0
        help
            GPIO0 是 ESP32-C3 的 BOOT strapping 引脚，复位瞬间不要按住按键，
            否则会进入下载模式。

    config APP_BUTTON_ACTIVE_LOW
        bool "按键低电平按下"
        default y

    config APP_LED_ACK_BLINK_MS
        int "发送指令后本板 LED 闪烁时长(ms)"
        default 60
        help
            按键发出指令后本板 LED 短暂点亮，用于确认数据已交给发送驱动。

endmenu
```
